## Documentation/devicetree/bindings/display/panel/iqiyi,a081-panel.yaml
```yaml
# SPDX-License-Identifier: (GPL-2.0-only OR BSD-2-Clause)
%YAML 1.2
---
$id: http://devicetree.org/schemas/display/panel/iqiyi,a081-panel.yaml#
$schema: http://devicetree.org/meta-schemas/core.yaml#

title: iQIYI Qiyu MIX A081 dual DSI display assembly

maintainers:
  - Qiyu Project <qiyu@example.invalid>

description: |
  The BID-08 display assembly uses two four-lane DSI links and DSC for a
  1920 by 3664 video-mode panel. The compatible identifies this board
  assembly; the vendor strings in the original firmware do not reliably
  identify the physical panel manufacturer. Port 0 is the primary link.
  Board control GPIOs follow the BID-08 sequence, including high levels
  on the boost and LED controls during normal shutdown.

allOf:
  - $ref: panel-common-dual.yaml#

properties:
  compatible:
    const: iqiyi,a081-panel
  reg:
    maxItems: 1
  vddio-supply:
    description: Panel 1.8 V I/O supply
  vsp-supply:
    description: Positive LCD bias supply
  vsn-supply:
    description: Negative LCD bias supply
  reset-gpios:
    maxItems: 1
    description: Active-low panel reset
  boost-gpios:
    maxItems: 1
    description: Board 5 V boost control
  io-enable-gpios:
    maxItems: 1
    description: Board display 1.8 V enable control
  led-5v-gpios:
    maxItems: 1
    description: LED 5 V control
  led1-gpios:
    maxItems: 1
    description: First LED driver control
  led2-gpios:
    maxItems: 1
    description: Second LED driver control
  pinctrl-names:
    items:
      - const: active
      - const: sleep
  pinctrl-0: true
  pinctrl-1: true
  ports:
    required:
      - port@0
      - port@1

required:
  - compatible
  - reg
  - vddio-supply
  - vsp-supply
  - vsn-supply
  - reset-gpios
  - boost-gpios
  - io-enable-gpios
  - led-5v-gpios
  - led1-gpios
  - led2-gpios
  - pinctrl-names
  - pinctrl-0
  - pinctrl-1
  - ports

unevaluatedProperties: false

examples:
  - |
    #include <dt-bindings/gpio/gpio.h>
    dsi {
        #address-cells = <1>;
        #size-cells = <0>;

        panel@0 {
            compatible = "iqiyi,a081-panel";
            reg = <0>;
            vddio-supply = <&vddio>;
            vsp-supply = <&lcdb_ldo>;
            vsn-supply = <&lcdb_ncp>;
            reset-gpios = <&tlmm 75 GPIO_ACTIVE_LOW>;
            boost-gpios = <&tlmm 3 GPIO_ACTIVE_HIGH>;
            io-enable-gpios = <&tlmm 140 GPIO_ACTIVE_HIGH>;
            led-5v-gpios = <&tlmm 134 GPIO_ACTIVE_HIGH>;
            led1-gpios = <&tlmm 0 GPIO_ACTIVE_HIGH>;
            led2-gpios = <&tlmm 1 GPIO_ACTIVE_HIGH>;
            pinctrl-names = "active", "sleep";
            pinctrl-0 = <&panel_active>;
            pinctrl-1 = <&panel_sleep>;
            ports {
                #address-cells = <1>;
                #size-cells = <0>;
                port@0 {
                    reg = <0>;
                    endpoint { remote-endpoint = <&dsi0_out>; };
                };
                port@1 {
                    reg = <1>;
                    endpoint { remote-endpoint = <&dsi1_out>; };
                };
            };
        };
    };
```

## Documentation/devicetree/bindings/media/i2c/sony,imx471.yaml
```yaml
# SPDX-License-Identifier: (GPL-2.0-only OR BSD-2-Clause)
%YAML 1.2
---
$id: http://devicetree.org/schemas/media/i2c/sony,imx471.yaml#
$schema: http://devicetree.org/meta-schemas/core.yaml#

title: Sony IMX471 CMOS image sensor

maintainers:
  - Kate Hsuan <hpa@redhat.com>

description:
  Sony IMX471 image sensor with an I2C control interface and a MIPI CSI-2
  output. The current driver supports a 19.2 MHz input clock and four lanes.

$ref: /schemas/media/video-interface-devices.yaml#

properties:
  compatible:
    const: sony,imx471
  reg:
    maxItems: 1
  clocks:
    maxItems: 1
  reset-gpios:
    maxItems: 1
    description: Active-low XCLR input.
  vana-supply:
    description: Analog supply, 2.8 V.
  vdig-supply:
    description: Digital core supply, 1.05 V.
  vif-supply:
    description: Digital interface supply, 1.8 V.
  port:
    $ref: /schemas/graph.yaml#/$defs/port-base
    unevaluatedProperties: false
    properties:
      endpoint:
        $ref: /schemas/media/video-interfaces.yaml#
        unevaluatedProperties: false
        properties:
          data-lanes:
            items:
              - const: 1
              - const: 2
              - const: 3
              - const: 4
          link-frequencies: true
        required:
          - data-lanes
          - link-frequencies

required:
  - compatible
  - reg
  - clocks
  - vana-supply
  - vdig-supply
  - vif-supply
  - port

unevaluatedProperties: false
```

## Documentation/devicetree/bindings/misc/iqiyi,a081-controller.yaml
```yaml
# SPDX-License-Identifier: (GPL-2.0-only OR BSD-2-Clause)
%YAML 1.2
---
$id: http://devicetree.org/schemas/misc/iqiyi,a081-controller.yaml#
$schema: http://devicetree.org/meta-schemas/core.yaml#

title: iQIYI A081 Nordic controller radio bridge

maintainers:
  - Qiyu Project <qiyu@example.invalid>

description: |
  Nordic radio assembly used for the Qiyu MIX controller link. It exchanges
  36-byte full-duplex SPI frames after a rising data-ready interrupt. The
  assembly has a power enable and an active-low reset. It is separate from
  the headset Bluetooth HCI controller.

allOf:
  - $ref: /schemas/spi/spi-peripheral-props.yaml#

properties:
  compatible:
    const: iqiyi,a081-controller

  reg:
    maxItems: 1

  spi-max-frequency:
    maximum: 8000000

  interrupts:
    maxItems: 1
    description: Data-ready interrupt, rising edge

  enable-gpios:
    maxItems: 1
    description: Radio assembly power enable

  reset-gpios:
    maxItems: 1
    description: Active-low radio reset

required:
  - compatible
  - reg
  - spi-max-frequency
  - interrupts
  - enable-gpios
  - reset-gpios

unevaluatedProperties: false

examples:
  - |
    #include <dt-bindings/gpio/gpio.h>
    #include <dt-bindings/interrupt-controller/irq.h>

    spi {
        #address-cells = <1>;
        #size-cells = <0>;

        radio@0 {
            compatible = "iqiyi,a081-controller";
            reg = <0>;
            spi-max-frequency = <8000000>;
            interrupt-parent = <&tlmm>;
            interrupts = <145 IRQ_TYPE_EDGE_RISING>;
            enable-gpios = <&tlmm 41 GPIO_ACTIVE_HIGH>;
            reset-gpios = <&tlmm 115 GPIO_ACTIVE_LOW>;
        };
    };
```

## Documentation/devicetree/bindings/power/supply/qcom,pm8150b-fg.yaml
```yaml
# SPDX-License-Identifier: (GPL-2.0-only OR BSD-2-Clause)
%YAML 1.2
---
$id: http://devicetree.org/schemas/power/supply/qcom,pm8150b-fg.yaml#
$schema: http://devicetree.org/meta-schemas/core.yaml#

title: Qualcomm PM8150B fuel gauge

maintainers:
  - Qiyu Project <qiyu@example.invalid>

description: |
  The GEN4 fuel gauge contains SOC, battery information, round-robin ADC,
  memory arbitration and six DMA windows. The register address identifies
  the SOC peripheral; the other blocks have fixed offsets from it.

allOf:
  - $ref: power-supply.yaml#

properties:
  compatible:
    const: qcom,pm8150b-fg

  reg:
    maxItems: 1

  interrupts:
    maxItems: 5

  interrupt-names:
    items:
      - const: soc-ready
      - const: msoc-delta
      - const: batt-missing
      - const: batt-temp-delta
      - const: vbatt-low

  monitored-battery: true

  qcom,fg-profile-data:
    $ref: /schemas/types.yaml#/definitions/uint8-array
    minItems: 416
    maxItems: 416
    description: |
      Battery characterization data for SRAM words 65 through 272. Algorithm
      nominal capacity in this data can differ from the battery design rating.

  qcom,battery-id-ohms:
    description: Battery identification resistor for this characterization profile.
    minimum: 1

  qcom,battery-id-tolerance-percent:
    minimum: 0
    maximum: 100
    description: Maximum difference from the identification resistor in percent.

  qcom,fg-full-voltage-microvolt:
    minimum: 2000000
    maximum: 5500000
    description: Gauge full-voltage threshold, no greater than battery design maximum.

  qcom,therm-coefficients:
    $ref: /schemas/types.yaml#/definitions/uint32-array
    minItems: 5
    maxItems: 5
    items:
      maximum: 65535
    description: Five 16-bit coefficients for the battery thermistor polynomial.

  qcom,therm-center-offset:
    $ref: /schemas/types.yaml#/definitions/uint32
    maximum: 255
    description: Battery thermistor ratio center offset.

  qcom,therm-pull-up-ohms:
    enum: [30000, 100000, 400000]
    description: Internal pull-up resistance for the battery thermistor.

required:
  - compatible
  - reg
  - interrupts
  - interrupt-names
  - monitored-battery
  - qcom,fg-profile-data
  - qcom,battery-id-ohms
  - qcom,battery-id-tolerance-percent
  - qcom,fg-full-voltage-microvolt
  - qcom,therm-coefficients
  - qcom,therm-center-offset
  - qcom,therm-pull-up-ohms

additionalProperties: false

examples:
  - |
    #include <dt-bindings/interrupt-controller/irq.h>

    pmic {
      #address-cells = <1>;
      #size-cells = <0>;

      fuel-gauge@4000 {
        compatible = "qcom,pm8150b-fg";
        reg = <0x4000>;
        interrupts = <2 0x40 1 IRQ_TYPE_EDGE_BOTH>,
                     <2 0x40 3 IRQ_TYPE_EDGE_RISING>,
                     <2 0x42 0 IRQ_TYPE_EDGE_BOTH>,
                     <2 0x42 2 IRQ_TYPE_EDGE_BOTH>,
                     <2 0x41 0 IRQ_TYPE_EDGE_BOTH>;
        interrupt-names = "soc-ready", "msoc-delta", "batt-missing",
                          "batt-temp-delta", "vbatt-low";
        monitored-battery = <&battery>;

        qcom,battery-id-ohms = <100000>;
        qcom,battery-id-tolerance-percent = <15>;
        qcom,fg-full-voltage-microvolt = <4390000>;
        qcom,therm-coefficients = <8984 3340 56055 50518 33933>;
        qcom,therm-center-offset = <112>;
        qcom,therm-pull-up-ohms = <100000>;
        qcom,fg-profile-data = [
          09 00 a2 ea 44 e5 91 ea 29 e5 00 00 dd bc 56 8b
          f6 87 a0 80 94 9d 43 80 16 00 98 05 36 0b 91 05
          a7 01 ce 07 32 00 ce ea a1 ed fd d3 62 0a ad c5
          14 bc 3d 1a 13 02 5e d3 60 00 42 00 44 00 43 00
          38 00 35 00 37 00 3b 00 42 00 44 00 3f 00 60 00
          3f 00 4a 00 48 00 45 00 3e 00 61 00 61 64 4f 00
          47 00 44 08 60 00 4b 00 53 00 62 08 5d 08 4b 00
          8a 18 6d 40 5b 50 50 0d 47 00 d8 00 87 1f 9f 0d
          4e 02 a6 06 cd 1c 28 0a 47 0d 0a 23 de 1a d7 43
          c9 55 9d 03 73 12 2c 20 f4 04 db 0a 0c 06 de 1c
          e5 f9 ee 05 4b 02 ef 17 52 23 38 45 32 53 80 13
          18 21 18 ec 67 d3 91 d5 ed 1c db a2 b3 05 bf ba
          7f 18 e4 8a a3 85 a6 9a 96 a8 09 80 6e fa 32 fd
          9a 02 86 fa 00 00 f3 ec 80 03 f5 df 6c da 5e bd
          f9 10 12 f0 87 dc 1b 03 db 05 21 03 ce 07 32 00
          5d 01 6e 02 84 07 c8 05 8f 03 cb 02 14 02 c2 03
          9a 05 49 00 3b 00 4b 00 4f 64 56 00 59 00 58 f8
          56 e8 54 00 59 00 61 08 51 08 35 00 46 28 4a 58
          54 70 5e 07 47 00 51 00 5d 08 68 00 59 00 49 00
          3d 10 4c 10 51 00 60 28 72 48 50 60 5b 0c 63 00
          62 00 4b 08 d8 f8 ae 1e 9f 07 0f 0a 97 0a 34 1d
          4c 22 49 45 c4 5a 7f 18 d7 03 fe 05 dc 02 6a 0f
          3f 0a 27 20 23 05 c4 02 0c 06 b3 1c 55 03 ad 05
          78 02 60 18 45 02 1a 05 91 02 6b 00 b4 1f 82 05
          9d 02 37 04 c8 1c ae 02 83 04 db 03 a0 18 7f 03
          6d 04 87 02 6c 00 a5 01 c0 00 fa 00 88 16 00 00
        ];
      };
    };
```

## Documentation/devicetree/bindings/power/supply/qcom,pmi8998-charger.yaml
```yaml
# SPDX-License-Identifier: GPL-2.0 OR BSD-2-Clause
%YAML 1.2
---
$id: http://devicetree.org/schemas/power/supply/qcom,pmi8998-charger.yaml#
$schema: http://devicetree.org/meta-schemas/core.yaml#

title: Qualcomm SMB2 and SMB5 Switch-Mode Battery Charger

maintainers:
  - Casey Connolly <casey.connolly@linaro.org>

properties:
  compatible:
    oneOf:
      - enum:
          - qcom,pmi8998-charger
          - qcom,pm660-charger
          - qcom,pm8150b-charger
      - items:
          - const: qcom,pm7250b-charger
          - const: qcom,pm8150b-charger

  reg:
    maxItems: 1

  interrupts:
    maxItems: 4

  interrupt-names:
    items:
      - const: usb-plugin
      - const: bat-ov
      - const: wdog-bark
      - const: usbin-icl-change

  io-channels:
    items:
      - description: USB input current or current-sense voltage measurement
      - description: USB input voltage measurement

  io-channel-names:
    items:
      - const: usbin_i
      - const: usbin_v

  monitored-battery: true

  power-supplies:
    description: Type-C port controller reporting the source current capability.
    maxItems: 1

  input-current-limit-microamp:
    description:
      Board maximum USB input current. Source detection may select a lower
      current, and userspace cannot request more than this limit.
    minimum: 500000
    maximum: 5000000
    multipleOf: 25000

required:
  - compatible
  - reg
  - interrupts
  - interrupt-names
  - io-channels
  - io-channel-names
  - monitored-battery

allOf:
  - $ref: power-supply.yaml#

additionalProperties: false

examples:
  - |
    #include <dt-bindings/interrupt-controller/irq.h>

    pmic {
      #address-cells = <1>;
      #size-cells = <0>;

      charger@1000 {
        compatible = "qcom,pmi8998-charger";
        reg = <0x1000>;

        interrupts = <0x2 0x12 0x2 IRQ_TYPE_EDGE_BOTH>,
                     <0x2 0x13 0x4 IRQ_TYPE_EDGE_BOTH>,
                     <0x2 0x13 0x6 IRQ_TYPE_EDGE_RISING>,
                     <0x2 0x16 0x1 IRQ_TYPE_EDGE_RISING>;
        interrupt-names = "usb-plugin", "bat-ov", "wdog-bark", "usbin-icl-change";

        io-channels = <&pmi8998_rradc 3>,
                      <&pmi8998_rradc 4>;
        io-channel-names = "usbin_i",
                           "usbin_v";

        monitored-battery = <&battery>;
      };
    };
```

## Documentation/devicetree/bindings/regulator/qcom,pm8150l-lcdb.yaml
```yaml
# SPDX-License-Identifier: (GPL-2.0-only OR BSD-2-Clause)
%YAML 1.2
---
$id: http://devicetree.org/schemas/regulator/qcom,pm8150l-lcdb.yaml#
$schema: http://devicetree.org/meta-schemas/core.yaml#

title: Qualcomm PM8150L LCD bias regulators

maintainers:
  - Qiyu Project <qiyu@example.invalid>

description: |
  PM8150L contains a shared boost converter feeding a positive LDO and a
  negative charge pump for LCD bias. Both outputs share the module enable.
  The NCP voltage constraints specify the absolute value of its output.
  The boost is an internal supply, not an independent panel supply output.

properties:
  compatible:
    const: qcom,pm8150l-lcdb

  reg:
    maxItems: 1

  interrupts:
    maxItems: 1
    description: Short circuit interrupt

  interrupt-names:
    const: sc-err

  ldo:
    type: object
    $ref: regulator.yaml#
    unevaluatedProperties: false

  ncp:
    type: object
    $ref: regulator.yaml#
    unevaluatedProperties: false

required:
  - compatible
  - reg
  - interrupts
  - interrupt-names
  - ldo
  - ncp

additionalProperties: false

examples:
  - |
    #include <dt-bindings/interrupt-controller/irq.h>

    pmic {
        #address-cells = <1>;
        #size-cells = <0>;

        regulator@ec00 {
            compatible = "qcom,pm8150l-lcdb";
            reg = <0xec00>;
            interrupts = <0x5 0xec 0x1 IRQ_TYPE_EDGE_RISING>;
            interrupt-names = "sc-err";

            ldo {
                regulator-name = "lcdb-ldo";
                regulator-min-microvolt = <5700000>;
                regulator-max-microvolt = <5900000>;
            };

            ncp {
                regulator-name = "lcdb-ncp";
                regulator-min-microvolt = <5700000>;
                regulator-max-microvolt = <5900000>;
            };
        };
    };
```
