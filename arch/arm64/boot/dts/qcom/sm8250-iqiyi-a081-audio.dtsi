// SPDX-License-Identifier: BSD-3-Clause
#define IQIYI_AUDIO_MODEL "Qiyu MIX WCD9385 DMIC"
#define IQIYI_AW88261_FIRMWARE "qcom/sm8250/iqiyi/a081/aw88261_acf.bin"
#include "sm8250-iqiyi-stereo-audio.dtsi"
#undef IQIYI_AW88261_FIRMWARE
#undef IQIYI_AUDIO_MODEL
